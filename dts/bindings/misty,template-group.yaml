## dts/bindings/misty,template-group.yaml
```yaml
compatible: "misty,template-group"

description: Demo for passing multiple instances to module.

properties:
  mw_templates:
    type: phandle-array
    required: true
    description: Array of phandles to instance nodes.
```

## dts/bindings/misty,template-instance.yaml
```yaml
compatible: "misty,template-instance"

description: Individual instance configuration.

properties:
  value:
    type: int
    required: true
    description: Instance Value.

  label:
    type: string
    required: true
    description: Human-readable name for this instance.
```

## test/testcase.yaml
```yaml
tests:
  template.tester:
    sysbuild: true
    platform_allow:
      - native_sim
    integration_platforms:
      - native_sim
    tags:
      - test_template
      - zbus
      - sysbuild
```
