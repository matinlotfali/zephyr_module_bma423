## Kconfig
```kconfig
menuconfig BMA423
	bool "BMA423 Accelerometer Driver"
	default n
	depends on I2C

if BMA423

config BMA423_INTERRUPTS
	bool "Enable interrupt support"
	depends on GPIO
	default n
	help
	  Enable interrupt support for BMA423. This allows asynchronous
	  notification of sensor events such as:
	  - Data ready
	  - Step counter watermark
	  - Activity change
	  - Tilt detection
	  - FIFO watermark/full
	  Both INT1 and INT2 pins are supported with flexible mapping.

config BMA423_PRIORITY
	int "Thread Priority"
	default 3

config BMA423_DELAY_START_MS
	int "Thread start delay ms"
	default 0

config BMA423_STACK_SIZE
	int "Thread stack size"
	default 2048

config BMA423_MSGQ_SIZE
	int "Message queue size"
	default 5

config BMA423_MSGQ_ALIGN
	int "Power of 2 msg queue byte alignment"
	default 4

config BMA423_WDT_TIMEOUT_S
	int "Watchdog timeout seconds"
	default 3

config BMA423_MSGQ_TIMEOUT_S
	int "Wait for message timeout seconds"
	default 1

config BMA423_SHELL
	bool "Enable Template Shell Console"
	default n

# https://docs.zephyrproject.org/latest/services/logging/index.html#logging-in-a-module
module = BMA423
module-str = BMA423
source "subsys/logging/Kconfig.template.log_config"

endif # BMA423
```

## dts/bindings/misty,bma423-group.yaml
```yaml
compatible: "misty,bma423-group"

description: Demo for passing multiple instances to module.

properties:
  mw_bma423s:
    type: phandle-array
    required: true
    description: Array of phandles to instance nodes.
```
